## config/boards/shields/SplitBoards/Kconfig.defconfig
```kconfig
if SHIELD_SPLITBOARDS_LEFT

config ZMK_KEYBOARD_NAME
    default "SplitBoards"

config ZMK_SPLIT_ROLE_CENTRAL
    default y

endif

if SHIELD_SPLITBOARDS_LEFT || SHIELD_SPLITBOARDS_RIGHT

config ZMK_SPLIT
    default y

endif
```

## config/boards/shields/SplitBoards/Kconfig.shield
```kconfig
config SHIELD_SPLITBOARDS_LEFT
    def_bool $(shields_list_contains,SplitBoards_left)

config SHIELD_SPLITBOARDS_RIGHT
    def_bool $(shields_list_contains,SplitBoards_right)
```
